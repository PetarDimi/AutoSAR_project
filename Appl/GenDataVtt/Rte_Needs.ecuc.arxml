AUTOSAR XML (schema 4-0-3)
package /DaVinci_Project
  module config Com
    ComConfig
      7 x ComSignal:
        sig_AmbientLightBrightness_In: ComSignalType=UINT8
        sig_CurrentSpeedSlider_In: ComSignalType=UINT8
        sig_LeftHAngle_Out: ComSignalType=SINT8
        sig_LeftLightLength_Out: ComSignalType=UINT8
        sig_RightHAngle_Out: ComSignalType=SINT8
        sig_RightLightLength_Out: ComSignalType=UINT8
        sig_SteeringWheelPosition_In: ComSignalType=UINT8
  module config Rte
    17 x RteBswModuleInstance:
      BswM
        BswM_MainFunctionTimingEvent0 (RteBswEventToTaskMapping): RteBswUsedOsEventRef=Rte_Ev_Cyclic2_SchM_Task_0_10ms, RteBswUsedOsAlarmRef=Os/Rte_Al_TE2_SchM_Task_0_10ms
      Can
        3 x RteBswEventToTaskMapping, all with RteBswUsedOsEventRef=Rte_Ev_Cyclic2_SchM_Task_0_10ms, RteBswUsedOsAlarmRef=Os/Rte_Al_TE2_SchM_Task_0_10ms:
          Can_MainFunction_BusOffTimingEvent0
          Can_MainFunction_ModeTimingEvent0
          Can_MainFunction_WakeupTimingEvent0
      CanIf
      CanNm
        CanNm_MainFunctionTimingEvent0 (RteBswEventToTaskMapping): RteBswUsedOsEventRef=Rte_Ev_Cyclic2_SchM_Task_0_10ms, RteBswUsedOsAlarmRef=Os/Rte_Al_TE2_SchM_Task_0_10ms
      CanSM
        CanSM_MainFunctionTimingEvent0 (RteBswEventToTaskMapping): RteBswUsedOsEventRef=Rte_Ev_Cyclic2_SchM_Task_0_10ms, RteBswUsedOsAlarmRef=Os/Rte_Al_TE2_SchM_Task_0_10ms
      CanTp
        CanTp_MainFunctionTimingEvent0 (RteBswEventToTaskMapping): RteBswUsedOsEventRef=Rte_Ev_Cyclic2_SchM_Task_0_5ms, RteBswUsedOsAlarmRef=Os/Rte_Al_TE2_SchM_Task_0_5ms
      Com
        Com_MainFunctionRxTimingEvent0 (RteBswEventToTaskMapping): RteBswUsedOsEventRef=Rte_Ev_Cyclic2_SchM_Task_0_10ms, RteBswUsedOsAlarmRef=Os/Rte_Al_TE2_SchM_Task_0_10ms
        Com_MainFunctionTxTimingEvent0 (RteBswEventToTaskMapping): RteBswUsedOsEventRef=Rte_Ev_Cyclic2_SchM_Task_0_10ms, RteBswUsedOsAlarmRef=Os/Rte_Al_TE2_SchM_Task_0_10ms
      ComM
        ComM_MainFunction_0TimingEvent0 (RteBswEventToTaskMapping): RteBswUsedOsEventRef=Rte_Ev_Cyclic2_SchM_Task_0_20ms, RteBswUsedOsAlarmRef=Os/Rte_Al_TE2_SchM_Task_0_20ms
      Dcm
        Dcm_MainFunctionTimingEvent0 (RteBswEventToTaskMapping): RteBswUsedOsEventRef=Rte_Ev_Cyclic2_SchM_Task_0_10ms, RteBswUsedOsAlarmRef=Os/Rte_Al_TE2_SchM_Task_0_10ms
      Dem
        Dem_MainFunctionTimingEvent0 (RteBswEventToTaskMapping): RteBswUsedOsEventRef=Rte_Ev_Cyclic2_SchM_Task_0_10ms, RteBswUsedOsAlarmRef=Os/Rte_Al_TE2_SchM_Task_0_10ms
      Det
      EcuM
        EcuM_MainFunctionTimingEvent0 (RteBswEventToTaskMapping): RteBswUsedOsEventRef=Rte_Ev_Cyclic2_SchM_Task_0_10ms, RteBswUsedOsAlarmRef=Os/Rte_Al_TE2_SchM_Task_0_10ms
      Fee
        Fee_MainFunctionTimingEvent0 (RteBswEventToTaskMapping): RteBswUsedOsEventRef=Rte_Ev_Cyclic2_SchM_Task_0_5ms, RteBswUsedOsAlarmRef=Os/Rte_Al_TE2_SchM_Task_0_5ms
      Fls
        Fls_MainFunctionTimingEvent0 (RteBswEventToTaskMapping): RteBswUsedOsEventRef=Rte_Ev_Cyclic2_SchM_Task_0_10ms, RteBswUsedOsAlarmRef=Os/Rte_Al_TE2_SchM_Task_0_10ms
      Nm
      NvM
        NvM_MainFunctionTimingEvent0 (RteBswEventToTaskMapping): RteBswUsedOsEventRef=Rte_Ev_Cyclic2_SchM_Task_0_10ms, RteBswUsedOsAlarmRef=Os/Rte_Al_TE2_SchM_Task_0_10ms
      PduR
    15 x RteSwComponentInstance:
      BswM_EcuSwComposition
        Timer_BswM_MainFunction (RteEventToTaskMapping): RteUsedOsEventRef=Rte_Ev_Cyclic2_SchM_Task_0_10ms, RteUsedOsAlarmRef=Os/Rte_Al_TE2_SchM_Task_0_10ms
      ComM_EcuSwComposition
        Timer_ComM_MainFunction_0 (RteEventToTaskMapping): RteUsedOsEventRef=Rte_Ev_Cyclic2_SchM_Task_0_20ms, RteUsedOsAlarmRef=Os/Rte_Al_TE2_SchM_Task_0_20ms
      CpApAVHController_EcuSwComposition
        4 x RteEventToTaskMapping, all with RteUsedOsEventRef=Rte_Ev_Run_CpApAFSController_RCtApAFSControllerLogic:
          DRT_RCtApAFSControllerLogic_PpAmbientLight_DeAmbientLight
          DRT_RCtApAFSControllerLogic_PpBateryMode_DeBateryMode
          DRT_RCtApAFSControllerLogic_PpSpeedometerValue_DeSpeedometerValue
          DRT_RCtApAFSControllerLogic_PpSteeringWheelPosition_DeSteeringWheelPosition
      CpApBatteryManager_EcuSwComposition
        3 x RteEventToTaskMapping:
          TMT_RCpApBatteryManager: RteUsedOsEventRef=Rte_Ev_Cyclic_IO_Task_0_100ms, RteUsedOsAlarmRef=Os/Rte_Al_TE_IO_Task_0_100ms
          MST_RCtApBatteryManagerComM_ModeChange_FULL_COMM_Entry_0: RteUsedOsEventRef=Rte_Ev_Run_CpApBatteryManager_RCtApBatteryManagerComM_ModeChange_FULL_COMM_Entry
          MST_RCtApBatteryManagerComM_ModeChange_FULL_COMM_Exit_0: RteUsedOsEventRef=Rte_Ev_Run_CpApBatteryManager_RCtApBatteryManagerComM_ModeChange_FULL_COMM_Exit
      CpCddIoHwAb_EcuSwComposition
      CpSaAmbientLight_EcuSwComposition
        TMT_RCtSaAmbientLightGetValue (RteEventToTaskMapping): RteUsedOsEventRef=Rte_Ev_Cyclic_IO_Task_0_100ms, RteUsedOsAlarmRef=Os/Rte_Al_TE_IO_Task_0_100ms
      CpSaHeadlight_EcuSwComposition
        DRT_RCtSaHeadlight_PpLightPosition_DeLightPosition_001 (RteEventToTaskMapping): RteUsedOsEventRef=Rte_Ev_Run_CpSaLeftFrontlight_RCtSaFrontlight
      CtSaRightHeadlight_EcuSwComposition
        DRT_RCtSaHeadlight_PpLightPosition_DeLightPosition_001 (RteEventToTaskMapping): RteUsedOsEventRef=Rte_Ev_Run_CpSaRightFrontlight_RCtSaFrontlight
      CpSaSpeedometer_EcuSwComposition
        TMT_RCtSaSpeedometerGetValue (RteEventToTaskMapping): RteUsedOsEventRef=Rte_Ev_Cyclic_IO_Task_0_100ms, RteUsedOsAlarmRef=Os/Rte_Al_TE_IO_Task_0_100ms
      CpSaSteeringWheel_EcuSwComposition
        TMT_RCtSaSteeringWheelGetPosition (RteEventToTaskMapping): RteUsedOsEventRef=Rte_Ev_Cyclic_IO_Task_0_100ms, RteUsedOsAlarmRef=Os/Rte_Al_TE_IO_Task_0_100ms
      Dcm_EcuSwComposition
        Timer_Dcm_MainFunction (RteEventToTaskMapping): RteUsedOsEventRef=Rte_Ev_Cyclic2_SchM_Task_0_10ms, RteUsedOsAlarmRef=Os/Rte_Al_TE2_SchM_Task_0_10ms
      Dem_EcuSwComposition
        Timer_Dem_MainFunction (RteEventToTaskMapping): RteUsedOsEventRef=Rte_Ev_Cyclic2_SchM_Task_0_10ms, RteUsedOsAlarmRef=Os/Rte_Al_TE2_SchM_Task_0_10ms
      Det_EcuSwComposition
      EcuM_EcuSwComposition
        Timer_EcuM_MainFunction (RteEventToTaskMapping): RteUsedOsEventRef=Rte_Ev_Cyclic2_SchM_Task_0_10ms, RteUsedOsAlarmRef=Os/Rte_Al_TE2_SchM_Task_0_10ms
      NvM_EcuSwComposition
        Timer_NvM_MainFunction (RteEventToTaskMapping): RteUsedOsEventRef=Rte_Ev_Cyclic2_SchM_Task_0_10ms, RteUsedOsAlarmRef=Os/Rte_Al_TE2_SchM_Task_0_10ms
    RteOsInteraction
      4 x RteUsedOsActivation, all with RteExpectedActivationOffset=0:
        Rte_Al_TE_IO_Task_0_100ms: RteActivationOsAlarmRef=Os/Rte_Al_TE_IO_Task_0_100ms, RteActivationOsTaskRef=IO_Task
        Rte_Al_TE2_SchM_Task_0_10ms: RteActivationOsAlarmRef=Os/Rte_Al_TE2_SchM_Task_0_10ms, RteActivationOsTaskRef=SchM_Task
        Rte_Al_TE2_SchM_Task_0_20ms: RteActivationOsAlarmRef=Os/Rte_Al_TE2_SchM_Task_0_20ms, RteActivationOsTaskRef=SchM_Task
        Rte_Al_TE2_SchM_Task_0_5ms: RteActivationOsAlarmRef=Os/Rte_Al_TE2_SchM_Task_0_5ms, RteActivationOsTaskRef=SchM_Task
  module config NvM
  module config Os
    IO_Task (OsTask):
      OsTaskActivation = 1
      OsTaskPriority = 3
      OsTaskSchedule = FULL
      OsTaskEventRef = Rte_Ev_Cyclic_IO_Task_0_100ms
      OsTaskEventRef = Rte_Ev_Run_CpSaLeftFrontlight_RCtSaFrontlight
      OsTaskEventRef = Rte_Ev_Run_CpSaRightFrontlight_RCtSaFrontlight
    Rte_Al_TE_IO_Task_0_100ms (OsAlarm): OsAlarmCounterRef=SystemTimer
      OsAlarmAction
        OsAlarmSetEvent: OsAlarmSetEventRef=Rte_Ev_Cyclic_IO_Task_0_100ms, OsAlarmSetEventTaskRef=IO_Task
    My_Task (OsTask):
      OsTaskActivation = 1
      OsTaskPriority = 2
      OsTaskSchedule = FULL
      OsTaskEventRef = Rte_Ev_Run_CpApAFSController_RCtApAFSControllerLogic
      OsTaskEventRef = Rte_Ev_Run_CpApBatteryManager_RCtApBatteryManagerComM_ModeChange_FULL_COMM_Entry
      OsTaskEventRef = Rte_Ev_Run_CpApBatteryManager_RCtApBatteryManagerComM_ModeChange_FULL_COMM_Exit
    SchM_Task (OsTask):
      OsTaskActivation = 1
      OsTaskPriority = 6
      OsTaskSchedule = FULL
      OsTaskEventRef = Rte_Ev_Cyclic2_SchM_Task_0_10ms
      OsTaskEventRef = Rte_Ev_Cyclic2_SchM_Task_0_20ms
      OsTaskEventRef = Rte_Ev_Cyclic2_SchM_Task_0_5ms
    3 x OsAlarm, all with OsAlarmCounterRef=SystemTimer:
      Rte_Al_TE2_SchM_Task_0_10ms
        OsAlarmAction
          OsAlarmSetEvent: OsAlarmSetEventRef=Rte_Ev_Cyclic2_SchM_Task_0_10ms, OsAlarmSetEventTaskRef=SchM_Task
      Rte_Al_TE2_SchM_Task_0_20ms
        OsAlarmAction
          OsAlarmSetEvent: OsAlarmSetEventRef=Rte_Ev_Cyclic2_SchM_Task_0_20ms, OsAlarmSetEventTaskRef=SchM_Task
      Rte_Al_TE2_SchM_Task_0_5ms
        OsAlarmAction
          OsAlarmSetEvent: OsAlarmSetEventRef=Rte_Ev_Cyclic2_SchM_Task_0_5ms, OsAlarmSetEventTaskRef=SchM_Task
    9 x OsEvent:
      Rte_Ev_Cyclic2_SchM_Task_0_10ms
      Rte_Ev_Cyclic2_SchM_Task_0_20ms
      Rte_Ev_Cyclic2_SchM_Task_0_5ms
      Rte_Ev_Cyclic_IO_Task_0_100ms
      Rte_Ev_Run_CpApAFSController_RCtApAFSControllerLogic
      Rte_Ev_Run_CpApBatteryManager_RCtApBatteryManagerComM_ModeChange_FULL_COMM_Entry
      Rte_Ev_Run_CpApBatteryManager_RCtApBatteryManagerComM_ModeChange_FULL_COMM_Exit
      Rte_Ev_Run_CpSaLeftFrontlight_RCtSaFrontlight
      Rte_Ev_Run_CpSaRightFrontlight_RCtSaFrontlight
  ecuc value collection DaVinci_Project: ecuc-values=[Com, Rte, Os, NvM]
